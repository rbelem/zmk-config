## config/west.yml
```yaml
---
manifest:
  remotes:
    - name: zmkfirmware
      url-base: https://github.com/zmkfirmware
    # Additional modules containing boards/shields/custom code can be listed here as well
    # See https://docs.zephyrproject.org/3.2.0/develop/west/manifest.html#projects
    - name: petejohanson
      url-base: https://github.com/petejohanson
    - name: urob
      url-base: https://github.com/urob
  projects:
    - name: zmk
      # remote: zmkfirmware
      # revision: main
      # remote: petejohanson
      # revision: feat/pointers-move-scroll
      remote: urob
      revision: main
      import: app/west.yml
  self:
    path: config
```
